/* Copyright (c) 2015, The Linux Foundation. All rights reserved.
 *
 * This program is free software; you can redistribute it and/or modify
 * it under the terms of the GNU General Public License version 2 and
 * only version 2 as published by the Free Software Foundation.
 *
 * This program is distributed in the hope that it will be useful,
 * but WITHOUT ANY WARRANTY; without even the implied warranty of
 * MERCHANTABILITY or FITNESS FOR A PARTICULAR PURPOSE.  See the
 * GNU General Public License for more details.
 */


/dts-v1/;

#include "msm8996-v3.dtsi"
#include "msm-pmi8996.dtsi"
#include "msm8996-htc_pmeuhljapan.dtsi"
#include "msm8996-camera-sensor-pme_xc.dtsi"
#include "msm8996-charger-pme_xc.dtsi"

/ {
	model = "HTC Corporation. MSM8996v3 PME_JAPAN XA";
	qcom,msm-id = <416 0x30001>; /* #UHL_JAPAN */
	qcom,board-id = <0x0 0>;
};

&spi_2 {
        htc_mcu@0 {
                mcu,need_notify_display = <0>;
                mcu,need_compass_filter = <1>;
        };
};
