/* Copyright (c) 2013-2014, The Linux Foundation. All rights reserved.
 *
 * This program is free software; you can redistribute it and/or modify
 * it under the terms of the GNU General Public License version 2 and
 * only version 2 as published by the Free Software Foundation.
 *
 * This program is distributed in the hope that it will be useful,
 * but WITHOUT ANY WARRANTY; without even the implied warranty of
 * MERCHANTABILITY or FITNESS FOR A PARTICULAR PURPOSE.  See the
 * GNU General Public License for more details.
 */

qcom,hima-id1-batterydata {
	qcom,max-voltage-uv = <4400000>;
	qcom,v-cutoff-uv = <3400000>;
	qcom,chg-term-ua = <100000>;
	qcom,nom-batt-capacity-mah = <2840>;
	qcom,batt-id-kohm = <10>;
	qcom,battery-beta = <4360>;
	qcom,battery-type = "hima_id1";
	qcom,checksum = <0x2DD6>;
	htc,batt_id = <1>;
	htc,id_raw_min = <2000>;
	htc,id_raw_max = <23000>;

	qcom,fg-profile-data = [
		 F3 83 9F 7D
		 BB 81 32 7C
		 43 83 4D 6B
		 13 71 5C 7F
		 0C 82 9A 9A
		 D0 BD 12 CB
		 5D 0E 08 88
		 33 7E 19 82
		 87 7C 53 83
		 96 68 14 7B
		 D3 87 42 82
		 F9 99 54 BD
		 6F CA 5B 0D
		 4E 0B 7A 5B
		 14 70 B8 FE
		 6C 37 30 44
		 3F 39 00 00
		 E0 45 25 2A
		 D7 45 00 00
		 00 00 00 00
		 00 00 00 00
		 4F 70 C4 70
		 BA 74 99 83
		 C7 74 71 60
		 86 67 1D 80
		 A0 74 81 5B
		 95 91 9C C1
		 1F 4C 69 5D
		 67 A0 71 0C
		 28 00 FF 36
		 F0 11 30 03
		 00 00 00 00
	];
};
