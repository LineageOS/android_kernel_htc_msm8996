&spmi_bus {
	qcom,pmi8994@3 {
		pmi8994_haptics: qcom,haptic@c000 {
			status = "okay";
			compatible = "qcom,qpnp-haptic";
			reg = <0xc000 0x100>;
			interrupts = <0x3 0xc0 0x0>,
				     <0x3 0xc0 0x1>;
			interrupt-names = "sc-irq", "play-irq";
			vcc_pon-supply = <&pon_perph_reg>;
			qcom,play-mode = "direct";
			qcom,wave-play-rate-us = <4255>;
			qcom,actuator-type = "lra";
			qcom,wave-shape = "sine";
			qcom,vmax-mv = <2828>;
			qcom,ilim-ma = <800>;
			qcom,sc-deb-cycles = <8>;
			qcom,int-pwm-freq-khz = <505>;
			qcom,en-brake;
			qcom,brake-pattern = [03 03 00 00];
			qcom,use-play-irq;
			qcom,use-sc-irq;
			qcom,wave-samples = [3e 3e 3e 3e 3e 3e 3e 3e];
			qcom,wave-rep-cnt = <1>;
			qcom,wave-samp-rep-cnt = <1>;
			qcom,lra-high-z = "opt1";
			qcom,lra-auto-res-mode = "qwd";
			qcom,lra-res-cal-period = <4>;
			htc,soft-mode-enable;
			htc,soft-mode-short-vib-vmax-mv = <2121>;
			htc,soft-mode-short-play-rate-us = <4878>;
			htc,soft-mode-vib-duration-ms = <40>;
		};
	};
};
