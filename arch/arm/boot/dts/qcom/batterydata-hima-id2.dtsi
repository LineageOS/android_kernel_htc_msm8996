/* Copyright (c) 2013-2014, The Linux Foundation. All rights reserved.
 *
 * This program is free software; you can redistribute it and/or modify
 * it under the terms of the GNU General Public License version 2 and
 * only version 2 as published by the Free Software Foundation.
 *
 * This program is distributed in the hope that it will be useful,
 * but WITHOUT ANY WARRANTY; without even the implied warranty of
 * MERCHANTABILITY or FITNESS FOR A PARTICULAR PURPOSE.  See the
 * GNU General Public License for more details.
 */

qcom,hima-id2-batterydata {
	qcom,max-voltage-uv = <4400000>;
	qcom,v-cutoff-uv = <3400000>;
	qcom,chg-term-ua = <100000>;
	qcom,nom-batt-capacity-mah = <2840>;
	qcom,batt-id-kohm = <33>;
	qcom,battery-beta = <4360>;
	qcom,battery-type = "hima_id2";
	qcom,checksum = <0x2DD6>;
	htc,batt_id = <2>;
	htc,id_raw_min = <23001>;
	htc,id_raw_max = <200000>;

	qcom,fg-profile-data = [
		 1A 88 0B 84
		 CD 83 62 7E
		 56 83 F5 55
		 CC 80 C7 86
		 2F 82 A8 98
		 1E B6 61 C1
		 6A 19 39 88
		 1B 85 C2 88
		 0F 84 5D 83
		 FA 5E 00 83
		 DE 8D 58 82
		 39 98 A7 B5
		 11 C1 5E 19
		 5C 0B FD 5B
		 14 70 B8 FE
		 A3 44 4F 47
		 8E 42 00 00
		 AD 47 25 32
		 8E 32 00 00
		 00 00 00 00
		 00 00 00 00
		 19 70 1F 70
		 1A 59 E6 88
		 16 75 E1 62
		 76 4C 93 80
		 AF 6F 0D 59
		 E8 8D 7C 93
		 1F D3 5A 51
		 5C A0 71 0C
		 28 00 FF 36
		 F0 11 30 03
		 00 00 00 00
	];
};
