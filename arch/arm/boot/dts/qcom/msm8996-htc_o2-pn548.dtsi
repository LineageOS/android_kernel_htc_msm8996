&i2c_8 {
	qcom,nack-as-normal = <0x28>;

	nxp_pn544_nfc@28 {
		compatible = "nxp,pn544-nfc";
		reg = <0x28>;
		interrupt-parent = <&tlmm>;
		interrupts = <50 0x4>;
		nxp,ven-gpio = <&tlmm 12 0x00>;
		nxp,irq-gpio = <&tlmm 50 0x00>;
		nxp,fwdl-gpio = <&tlmm 74 0x00>;
		nfc_i2c_sda = <&tlmm 6 0x00>;
		nfc_i2c_scl = <&tlmm 7 0x00>;
		nxp,ven_isinvert = <0>;
		nxp,isalive = <1>;
	};
};
