## arch/arm64/Kconfig.htc
```kconfig
comment "HTC Debugging Features"
menuconfig HTC_DEBUG
	bool "HTC Debugging Feature Switch"
	default n
	help
	  Enable collection of debug features.
	  This feature is enabled in defconfig.

config HTC_DEBUG_RTB
	default n
	depends on HTC_DEBUG && MSM_RTB
	bool "HTC style rtb debug features"
	help
	  Say Y here if you want the HTC style rtb debug features

config HTC_DEBUG_SSR
	bool "HTC style subsys restart debug features"
	default n
	depends on HTC_DEBUG && MSM_SUBSYSTEM_RESTART
	help
	  Say Y here if you want the HTC style subsys restart debug features

config HTC_POWER_DEBUG
	bool "Support htc power debug feature"
	help
	  Use this to enable htc power debug feature including pm statistics,
	  clock/gpio/qpnp pin dump, wakeup source, kerenl top and autosuspend
	  stage footprint

comment "HTC features"
menuconfig HTC_FEATURES
	bool "HTC Implement Features"
	default n
	help
	  Enable collection of HTC features.
	  This feature is enabled in defconfig.

config HTC_FEATURES_SSR
	bool "HTC style ssr features"
	depends on HTC_FEATURES && MSM_SUBSYSTEM_RESTART
	default n
	help
	  Say Y here if you want the HTC style ssr features

#HTC_AUD_START
config HTC_DEBUG_DSP
        bool "HTC debug feature for trigger ramdump when lpass related timeout"
        depends on HTC_DEBUG
        default n
        help
          This option enables the trigger ramdump when lpass command timeout.
#HTC_AUD_END

config HTC_FEATURES_SSR_MODEM_ENABLE
	bool "HTC style modem ssr features"
	depends on HTC_FEATURES_SSR
	default n
	help
	  Say Y here if you want the HTC style for modem ssr features

config HTC_FEATURES_SSR_LPASS_ENABLE
	bool "HTC style lpass ssr features"
	depends on HTC_FEATURES_SSR
	default n
	help
	  Say Y here if you want the HTC style for lpass ssr features

config HTC_FEATURES_SSR_SLPI_ENABLE
	bool "HTC style slpi ssr features"
	depends on HTC_FEATURES_SSR
	default n
	help
	  Say Y here if you want the HTC style for slpi ssr features

config HTC_FEATURES_SSR_WCNSS_ENABLE
	bool "HTC style wcnss ssr features"
	depends on HTC_FEATURES_SSR
	default n
	help
	  Say Y here if you want the HTC style for wcnss ssr features

config HTC_DEBUG_MEM_DUMP_TABLE
	bool "HTC style memory dump table features"
	depends on HTC_DEBUG
	help
	  Say Y here if you want the HTC style memory dump table features

config LMK_ZYGOTE_PROTECT
	bool "LMK zygote protect"
	default n
	help
	  Say Y here if you want the HTC style for protecting zygote to be killed by LMK with invalid adj values
```

## drivers/htc_debug/stability/Kconfig
```kconfig
#
# HTC_DEBUG stability Kconfig
#

config HTC_HELPER_FUNCTIONS
	bool "HTC helper functions"
	depends on HTC_DEBUG
	default n
	help
	  Extract debug flag from kernel cmdline and define read-only
	  functions to global kernel space

config HTC_DEBUG_RAMOOPS
	bool "Log panic/oops to a RAM buffer"
	default n
	depends on PSTORE_CONSOLE
	help
	  This enables panic and oops messages to be logged to a circular
	  buffer in RAM where it can be read back at some later point.

config HTC_REBOOT_BLOCK
	bool "Store reboot reason / msg ...etc. in IMEM or storage"
	default n
	help
	  Say Y here if you want the HTC Reboot Block features

config HTC_DEBUG_SAVE_BOOT_MSG
	default n
	depends on HTC_DEBUG
	bool "HTC debug: saving kernel log of booting to memory"
```

## drivers/htc_msm_serial/Kconfig
```kconfig
config HTC_MSM_SERIAL
    bool "HTC msm serial number"
    default y
    help
      Say yes to enable get msm serial number.
```

## drivers/htc_ril/Kconfig
```kconfig
config HTC_RADIO_SMEM
	bool "RADIO SMEM"
	default N
	---help---
	Enable to move necessary non-secure data to shared memory

config HTC_MODEM_NOTIFIER
	bool "MODEM NOTIFIER"
	default N
	---help---
	Enable to notify modem APP is rebooting

config HTC_GARBAGE_FILTER
	tristate "HTC_GARBAGE_FILTER"
	default n
	depends on MSM_SMD
	---help---
	  HTC Garbage Filter of TCP
```

## drivers/misc/fpr_FingerprintCard/Kconfig
```kconfig
#
# TI's shared transport line discipline and the protocol
# drivers (BT, FM and GPS)
#
menu "FingerprintCard fingerprint SPI driver"
config FPR_FPC
       default n
       tristate "FPC_BTP fingerprint sensor support"
       depends on SPI_MASTER

config FPC_HTC_DISABLE_CHARGING
       tristate "HTC FPC disable charging while capturing image during enroll/verify"
       depends on FPR_FPC
       default n

config FPC_HTC_RECORD_IRQ_COUNT
       tristate "HTC record IRQ count to check if interrupt works properly"
       depends on FPR_FPC
       default y

config FPC_HTC_ADD_INPUT_DEVICE
       tristate "HTC add input_dev to implement home key"
       depends on FPR_FPC
       default y

endmenu
```

## drivers/misc/headset/Kconfig
```kconfig
config HTC_HEADSET_MGR
	tristate "HTC headset manager driver"
	default n
	help
	  Provides support of HTC headset manager.

config HTC_HEADSET_GPIO
	tristate "HTC GPIO headset detection driver"
	depends on HTC_HEADSET_MGR
	default n
	help
	  Provides support of HTC GPIO headset detection.

config HTC_HEADSET_PMIC
	tristate "HTC PMIC headset detection driver"
	depends on HTC_HEADSET_MGR
	default n
	help
	  Provides support of HTC PMIC headset detection.

config HTC_HEADSET_ONE_WIRE
	tristate "HTC 1-wire headset detection driver"
	depends on HTC_HEADSET_MGR
	default n
	help
	  Provides support of HTC 1-wire headset detection.

config HTC_HEADSET_INT_REDETECT
	tristate "HTC headset key interrupt re-detection"
	depends on HTC_HEADSET_MGR
	default n
	help
	  Support key interrupt re-detection

config HTC_INSERT_NOTIFY_DELAY
	tristate "HTC headset insert notify delay"
	depends on HTC_HEADSET_MGR
	default n
	help
	  delay headset insert notify

config HTC_HEADSET_L_RMT_KEY_DESIGN
	tristate "Google new feature"
	depends on HTC_HEADSET_MGR
	default n
```
